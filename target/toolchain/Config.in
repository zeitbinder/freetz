## target/toolchain/Config.in
```kconfig
config FREETZ_MAKE_TOOLCHAIN
	bool "Build the Freetz based Toolchain"
	depends !FREETZ_EXTERNAL_TOOLCHAIN
	help
	  This is essentially the toolchain created by Freetz.
```

## toolchain/Config.in
```kconfig
comment "Kernel toolchain options ----------------------------------"
source toolchain/kernel/Config.in

comment "Target toolchain options ----------------------------------" 
source toolchain/target/Config.in

if FREETZ_BUILD_TOOLCHAIN
comment "Both kernel and target toolchain related options ----------"
config FREETZ_TOOLCHAIN_MINIMIZE_REQUIRED_GLIBC_VERSION
	#bool "Minimize required GLIBC version" if FREETZ_BUILD_TOOLCHAIN
	bool
	default y

config FREETZ_TOOLCHAIN_32BIT
	bool "Build 32-bit toolchains" if FREETZ_BUILD_TOOLCHAIN
	default n
	help
		This option causes a 32-bit toolchain to be built even on 64-bit systems.
endif # FREETZ_BUILD_TOOLCHAIN #


config FREETZ_EXTERNAL_KERNEL_TREE
	string "Use externanl kernel tree" if FREETZ_DEVEL
	default ""
```

## toolchain/kernel/Config.in
```kconfig
#
source toolchain/kernel/binutils/Config.in

source toolchain/kernel/gcc/Config.in

config FREETZ_KERNEL_BINUTILS_VERSION
	string
	default "2.18"   if FREETZ_KERNEL_BINUTILS_2_18
	default "2.22"   if FREETZ_KERNEL_BINUTILS_2_22
	default "2.23.2" if FREETZ_KERNEL_BINUTILS_2_23

config FREETZ_KERNEL_GCC_VERSION
	string
	default "3.4.6" if FREETZ_KERNEL_GCC_3_4
	default "4.6.4" if FREETZ_KERNEL_GCC_4_6
	default "4.7.3" if FREETZ_KERNEL_GCC_4_7
```

## toolchain/kernel/binutils/Config.in
```kconfig
choice
	prompt "Kernel binutils"
	default FREETZ_KERNEL_BINUTILS_2_18 if FREETZ_AVM_GCC_3_4
	default FREETZ_KERNEL_BINUTILS_2_22 if FREETZ_AVM_GCC_4_6
	default FREETZ_KERNEL_BINUTILS_2_22 if FREETZ_AVM_GCC_4_7

	config FREETZ_KERNEL_BINUTILS_2_18
		bool "binutils-2.18"
		depends on FREETZ_AVM_GCC_3_4

	config FREETZ_KERNEL_BINUTILS_2_22
		bool "binutils-2.22"
		depends on FREETZ_AVM_GCC_4_6 || FREETZ_AVM_GCC_4_7

	config FREETZ_KERNEL_BINUTILS_2_23
		bool "binutils-2.23.2 - EXPERIMENTAL"
		depends on FREETZ_AVM_GCC_4_6 && (FREETZ_BUILD_TOOLCHAIN || FREETZ_DL_TOOLCHAIN_OVERRIDE)
endchoice
```

## toolchain/kernel/gcc/Config.in
```kconfig
# Choose gcc version

choice
	prompt "Kernel compiler"
	default FREETZ_KERNEL_GCC_3_4 if FREETZ_AVM_GCC_3_4
	default FREETZ_KERNEL_GCC_4_6 if FREETZ_AVM_GCC_4_6
	default FREETZ_KERNEL_GCC_4_7 if FREETZ_AVM_GCC_4_7

	config FREETZ_KERNEL_GCC_3_4
		bool "gcc-3.4.6"
		depends on FREETZ_AVM_GCC_3_4

	config FREETZ_KERNEL_GCC_4_6
		bool "gcc-4.6.4"
		depends on FREETZ_AVM_GCC_4_6

	config FREETZ_KERNEL_GCC_4_7
		bool "gcc-4.7.3"
		depends on FREETZ_AVM_GCC_4_7
endchoice
```

## toolchain/target/Config.in
```kconfig
#
source toolchain/target/binutils/Config.in

source toolchain/target/gcc/Config.in

source toolchain/target/uClibc/Config.in

config FREETZ_USE_UCLIBC
	bool
	default y

source toolchain/target/gcc/Config.version

source toolchain/target/uClibc/Config.version

config FREETZ_LIBC
	string
	default "uClibc"  if FREETZ_USE_UCLIBC

config FREETZ_LIBC_VERSION
	string
	default FREETZ_TARGET_UCLIBC  if FREETZ_USE_UCLIBC

config FREETZ_TARGET_SUFFIX
	string
	default "uclibc"          if FREETZ_USE_UCLIBC

config FREETZ_STDCXXLIB
	string
	default "uclibcxx"if FREETZ_STDCXXLIB_USE_UCLIBCXX
	default "libstdcxx"if FREETZ_STDCXXLIB_USE_GNULIBSTDCXX

config FREETZ_TARGET_CFLAGS
	string "Target compiler flags"
	default "-Os -pipe -Wa,--trap"

config FREETZ_TARGET_TOOLCHAIN_AVM_COMPATIBLE
	bool "Create toolchain compatible with original firmware"
	depends on FREETZ_BUILD_TOOLCHAIN && (FREETZ_AVM_UCLIBC_0_9_28 || FREETZ_AVM_UCLIBC_0_9_29)
	default n
	help
		In order to produce smaller binaries freetz toolchain is compiled
		with mips-plt optimizations enabled. Because of the missing support
		for the required relocation types in uClibc versions prior to 0.9.30
		the binaries produced with a toolchain optimized this way could not
		be run on boxes with original firmware.

		This option causes mips-plt optimizations to be disabled.
		The binaries compiled with such toolchain could be run on boxes
		with unmodified firmware.

		Note: mips-plt optimizations affect only dynamically linked binaries.
		In case all binaries you want to run on an unmodified box will be
		linked statically it is safe to say 'no' here.



config FREETZ_TARGET_NLS
#	bool "Native language support (NLS) for target toolchain" if FREETZ_BUILD_TOOLCHAIN
	bool
	default n
	help
		Support NLS-enabled programs and Linux tools on target system.

		Example:
			$ ls /foo/bar
			ls: /foo/bar: No such file or directory
			$ export LANG=de_DE.8859-1
			$ ls /foo/bar
			ls: /foo/bar: Datei oder Verzeichnis nicht gefunden

config FREETZ_TARGET_LFS
	bool "Large file support (LFS) for target toolchain" if FREETZ_BUILD_TOOLCHAIN
	default y
	select FREETZ_BUSYBOX_LFS
	help
		Support files > 2 GB on target system. This is desirable for Torrent
		clients, for example. This option is enabled by default and should not
		be changed unless you know what you are doing, as it can easily cause
		problems.

config FREETZ_TARGET_TOOLCHAIN
#	select FREETZ_LIB_libgmp
#	select FREETZ_LIB_libmpfr
#	select FREETZ_LIB_libmpc
	bool "Build binutils and gcc for target" if FREETZ_BUILD_TOOLCHAIN
	default n
	help
		Build the binutils and gcc to run on the target.
		Files are installed into toolchain/target/target-utils.
```

## toolchain/target/binutils/Config.in
```kconfig
# Choose binutils version.

choice
	prompt "Target binutils"
	default FREETZ_TARGET_BINUTILS_2_22
	help
	  Select the version of binutils you wish to use.

	config FREETZ_TARGET_BINUTILS_2_22
		bool "binutils-2.22"

	config FREETZ_TARGET_BINUTILS_2_23
		bool "binutils-2.23.2"
		depends on FREETZ_BUILD_TOOLCHAIN || FREETZ_DL_TOOLCHAIN_OVERRIDE
endchoice

#config FREETZ_EXTRA_BINUTILS_CONFIG_OPTIONS
#	string
#	prompt "Additional binutils configure options"
#	default ""
#	help
#	    Any additional binutils options you may want to include....

config FREETZ_TARGET_BINUTILS_VERSION
	string
	default "2.22"		if FREETZ_TARGET_BINUTILS_2_22
	default "2.23.2"	if FREETZ_TARGET_BINUTILS_2_23
```

## toolchain/target/gcc/Config.in
```kconfig
# Choose gcc version.

choice
	prompt "Target compiler"
	default FREETZ_TARGET_GCC_4_6 if !FREETZ_AVM_GCC_4_7
	default FREETZ_TARGET_GCC_4_7 if  FREETZ_AVM_GCC_4_7

	config FREETZ_TARGET_GCC_4_6
		bool "gcc-4.6.4"
		depends on !FREETZ_AVM_GCC_4_7

	config FREETZ_TARGET_GCC_4_7
		bool "gcc-4.7.3"
		depends on FREETZ_AVM_GCC_4_7 \
			|| FREETZ_BUILD_TOOLCHAIN || FREETZ_DL_TOOLCHAIN_OVERRIDE

	config FREETZ_TARGET_GCC_4_8
		bool "gcc-4.8.0 - HIGHLY EXPERIMENTAL"
		depends on FREETZ_BUILD_TOOLCHAIN || FREETZ_DL_TOOLCHAIN_OVERRIDE
endchoice

choice
	prompt "Standard C++ library"
	default FREETZ_STDCXXLIB_USE_UCLIBCXX
	help
		Library to be used as the implementation of the Standard C++ Library.

	config FREETZ_STDCXXLIB_USE_UCLIBCXX
		bool "uClibc++"
		help
			uClibc++ is an implementation of the Standard C++ Library optimized
			for embedded systems (primarily for size). Its size is ~160KB.
			It however lacks a complete support for wchar type. It also has some
			performance deficiencies, e.g. std::map::find requires O(n), bubble
			sort O(n^2) is used as sort algorithm, and etc.

	config FREETZ_STDCXXLIB_USE_GNULIBSTDCXX
		bool "GNU libstdc++"
		help
			GNU libstdc++ is an implementation of the Standard C++ Library from
			the developers of the GNU Compiler Collection (GCC). It provides
			a full support for all features defined in the 2nd edition of the
			C++ Standard (ISO/IEC 14882:2003) and for many features of the
			upcoming version of the Standard. The only disadvantage it has
			compared to uClibc++ is its size - upto 900KB depending on the
			compiler version.

endchoice
```

## toolchain/target/uClibc/Config.in
```kconfig
# Choose uclibc version

choice
        prompt "Target uClibc version"
        default FREETZ_TARGET_UCLIBC_0_9_28 if FREETZ_AVM_UCLIBC_0_9_28
        default FREETZ_TARGET_UCLIBC_0_9_29 if FREETZ_AVM_UCLIBC_0_9_29
        default FREETZ_TARGET_UCLIBC_0_9_32 if FREETZ_AVM_UCLIBC_0_9_32
        default FREETZ_TARGET_UCLIBC_0_9_33 if FREETZ_AVM_UCLIBC_0_9_33

        config FREETZ_TARGET_UCLIBC_0_9_28
        bool "0.9.28"
        depends on FREETZ_AVM_UCLIBC_0_9_28

        config FREETZ_TARGET_UCLIBC_0_9_29
        bool "0.9.29"
        depends on FREETZ_AVM_UCLIBC_0_9_29

        config FREETZ_TARGET_UCLIBC_0_9_32
        bool "0.9.32.1"
        depends on FREETZ_AVM_UCLIBC_0_9_32 \
                || ((FREETZ_BUILD_TOOLCHAIN || FREETZ_DL_TOOLCHAIN_OVERRIDE) \
                && FREETZ_AVM_UCLIBC_0_9_29)

        config FREETZ_TARGET_UCLIBC_0_9_33
        bool "0.9.33.2"
        depends on FREETZ_AVM_UCLIBC_0_9_33 \
			|| (FREETZ_BUILD_TOOLCHAIN || FREETZ_DL_TOOLCHAIN_OVERRIDE) \
			&& (FREETZ_AVM_UCLIBC_0_9_29 || FREETZ_AVM_UCLIBC_0_9_32)
endchoice

config FREETZ_TARGET_UCLIBC_REDUCED_LOCALE_SET
	bool "Use reduced set of locales" if FREETZ_BUILD_TOOLCHAIN && \
		( \
			FREETZ_TARGET_UCLIBC_0_9_29 || \
			FREETZ_TARGET_UCLIBC_0_9_32 || \
			FREETZ_TARGET_UCLIBC_0_9_33    \
		)
	default y
	help
		This option causes only the following locales to be included into uClibc:
		 - en_US
		 - en_US.UTF-8
		 - de_DE
		 - de_DE.UTF-8

		This saves about 235KB in the image and at run-time.

comment "CAUTION: Usage of an uClibc version higher than that used by AVM may lead to an unstable box"
        depends on (FREETZ_AVM_UCLIBC_0_9_29 && !FREETZ_TARGET_UCLIBC_0_9_29) \
                || (FREETZ_AVM_UCLIBC_0_9_32 && !FREETZ_TARGET_UCLIBC_0_9_32)
```
